/* Copyright (c) 2013, The Linux Foundation. All rights reserved.
 *
 * This program is free software; you can redistribute it and/or modify
 * it under the terms of the GNU General Public License version 2 and
 * only version 2 as published by the Free Software Foundation.
 *
 * This program is distributed in the hope that it will be useful,
 * but WITHOUT ANY WARRANTY; without even the implied warranty of
 * MERCHANTABILITY or FITNESS FOR A PARTICULAR PURPOSE.  See the
 * GNU General Public License for more details.
 */

/*---------------------------------------------------------------------------
 * This file is autogenerated file using gcdb parser. Please do not edit it.
 * Update input XML file to add a new entry or update variable in this file
 * VERSION = "1.0"
 *---------------------------------------------------------------------------*/

/* =======================================================================
 *
 * when        	who         	why                           					comment tag
 *
 * ----------	---------	-------------------------------------				--------------------------
 * 2014-03-08	guofeizhi	Lower LCM refresh rate to improve wireless performance		FEIXUN_LOWER_LCM_REFRESH_RATE_GUOFEIZHI_001
 *
 */

&mdss_mdp {
	dsi_ili9806c_wvga_vid:qcom,mdss_dsi_ili9806c_wvga_video {
		qcom,mdss-dsi-panel-name = "ili9806c wvga video mode dsi panel";
		qcom,mdss-dsi-panel-controller = <&mdss_dsi0>;
		qcom,mdss-dsi-panel-type = "dsi_video_mode";
		qcom,mdss-dsi-panel-destination = "display_1";
		qcom,mdss-dsi-panel-framerate = <60>;
		qcom,mdss-dsi-virtual-channel-id = <0>;
		qcom,mdss-dsi-stream = <0>;
		qcom,mdss-dsi-panel-width = <480>;
		qcom,mdss-dsi-panel-height = <800>;
		qcom,mdss-dsi-h-front-porch = <70>;
		qcom,mdss-dsi-h-back-porch = <70>;
		qcom,mdss-dsi-h-pulse-width = <10>;
		qcom,mdss-dsi-h-sync-skew = <0>;
		qcom,mdss-dsi-v-back-porch = <16>;
		qcom,mdss-dsi-v-front-porch = <20>;
		qcom,mdss-dsi-v-pulse-width = <4>;
		qcom,mdss-dsi-h-left-border = <0>;
		qcom,mdss-dsi-h-right-border = <0>;
		qcom,mdss-dsi-v-top-border = <0>;
		qcom,mdss-dsi-v-bottom-border = <0>;
		qcom,mdss-dsi-bpp = <24>;
		qcom,mdss-dsi-underflow-color = <0xff>;
		qcom,mdss-dsi-border-color = <0>;
		qcom,mdss-dsi-on-command = [
			39 01 00 00 00 00 04
			FF FF 98 16
			15 01 00 00 00 00 02
			BA 60
			15 01 00 00 00 00 02
			B0 01
			39 01 00 00 00 00 18
			BC 03 0D 63 31 01 01 1B 10 37
			13 10 37 32 32 19 00 FF E2 01
			05 05 43 0B
			39 01 00 00 00 00 09
			BD 01 23 45 67 01 23 45 67
			39 01 00 00 00 00 12
			BE 00 22 22 22 97 86 CA DB AC
			BD 68 79 22 22 22 22 22
			39 01 00 00 00 00 03
			ED 7F 0F
			15 01 00 00 00 00 02
			F3 70
			15 01 00 00 00 00 02
			B4 00
			39 01 00 00 00 00 04
			C0 9F 0B 08
			39 01 00 00 00 00 05
			C1 17 80 80 20
			15 01 00 00 00 00 02
			D8 50
			15 01 00 00 00 00 02
			FC 08
			39 01 00 00 00 00 11
			E0 00 0C 23 13 15 1F CB 08 04
			08 03 0F 13 26 24 00
			39 01 00 00 00 00 11
			E1 00 09 15 11 13 17 79 08 03
			08 06 0B 08 27 21 00
			39 01 00 00 00 00 09
			D5 0D 0A 0A 0A CB A5 01 04
			15 01 00 00 00 00 02
			F7 8A
			15 01 00 00 00 00 02
			C7 8C
			15 01 00 00 00 00 02
			36 00
			15 01 00 00 00 00 02
			FA 84
			05 01 00 00 96 00 02
			11 00
			05 01 00 00 78 00 02
			29 00
			];
		qcom,mdss-dsi-off-command = [05 01 00 00 32 00 02 28 00
			05 01 00 00 78 00 02 10 00];
		qcom,mdss-dsi-on-command-state = "dsi_lp_mode";
		qcom,mdss-dsi-off-command-state = "dsi_lp_mode";
		qcom,mdss-dsi-h-sync-pulse = <1>;
		qcom,mdss-dsi-traffic-mode = "non_burst_sync_pulse";
		qcom,mdss-dsi-lane-map = "lane_map_3012";
		qcom,mdss-dsi-bllp-eof-power-mode;
		qcom,mdss-dsi-bllp-power-mode;
		qcom,mdss-dsi-lane-0-state;
		qcom,mdss-dsi-lane-1-state;
		qcom,mdss-dsi-panel-timings = [75 1A 11 00 3D 45 15 1D 1C 03 04 00];
		qcom,mdss-dsi-t-clk-post = <0x04>;
		qcom,mdss-dsi-t-clk-pre = <0x1b>;
		qcom,mdss-dsi-bl-min-level = <1>;
		qcom,mdss-dsi-bl-max-level = <31>;
		qcom,mdss-dsi-dma-trigger = "trigger_sw";
		qcom,mdss-dsi-mdp-trigger = "none";
		qcom,mdss-dsi-bl-pmic-control-type = "bl_ctrl_gpio";
		qcom,mdss-dsi-reset-sequence = <1 20>, <0 20>, <1 20>;
	};
};
