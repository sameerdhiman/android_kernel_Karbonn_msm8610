/* Copyright (c) 2013, The Linux Foundation. All rights reserved.
 *
 * This program is free software; you can redistribute it and/or modify
 * it under the terms of the GNU General Public License version 2 and
 * only version 2 as published by the Free Software Foundation.
 *
 * This program is distributed in the hope that it will be useful,
 * but WITHOUT ANY WARRANTY; without even the implied warranty of
 * MERCHANTABILITY or FITNESS FOR A PARTICULAR PURPOSE.  See the
 * GNU General Public License for more details.
 */

/*---------------------------------------------------------------------------
 * This file is autogenerated file using gcdb parser. Please do not edit it.
 * Update input XML file to add a new entry or update variable in this file
 * VERSION = "1.0"
 *---------------------------------------------------------------------------*/
&mdss_mdp {
	dsi_fl10801a_wvga_ips_vid:qcom,mdss_dsi_fl10801a_wvga_ips_video {
		qcom,mdss-dsi-panel-name = "fl10801a wvga ips video mode dsi panel";
		qcom,mdss-dsi-panel-controller = <&mdss_dsi0>;
		qcom,mdss-dsi-panel-type = "dsi_video_mode";
		qcom,mdss-dsi-panel-destination = "display_1";
		qcom,mdss-dsi-panel-frame-rate = <55>;
		qcom,mdss-dsi-virtual-channel-id = <0>;
		qcom,mdss-dsi-stream = <0>;
		qcom,mdss-dsi-panel-width = <480>;
		qcom,mdss-dsi-panel-height = <854>;
		qcom,mdss-dsi-h-front-porch = <32>;
		qcom,mdss-dsi-h-back-porch = <32>;
		qcom,mdss-dsi-h-pulse-width = <4>;
		qcom,mdss-dsi-h-sync-skew = <0>;
		qcom,mdss-dsi-v-front-porch = <18>;
		qcom,mdss-dsi-v-back-porch = <12>;
		qcom,mdss-dsi-v-pulse-width = <4>;
		qcom,mdss-dsi-h-left-border = <0>;
		qcom,mdss-dsi-h-right-border = <0>;
		qcom,mdss-dsi-v-top-border = <0>;
		qcom,mdss-dsi-v-bottom-border = <0>;
		qcom,mdss-dsi-bpp = <24>;
		qcom,mdss-dsi-color-order = <0>;
		qcom,mdss-dsi-underflow-color = <0xff>;
		qcom,mdss-dsi-border-color = <0>;
		qcom,mdss-dsi-on-command = [
			39 01 00 00 00 00 04
			B9 F1 08 01
			39 01 00 00 00 00 05
			B1 22 1E 1E 87
			39 01 00 00 00 00 02
			B2 22
			39 01 00 00 00 00 09
			B3 00 00 06 06 20 20 
			30 30
			39 01 00 00 00 00 12
			BA 31 00 44 25 91 0A
			00 00 C1 00 00 00 0D
			02 1D B9 EE
			39 01 00 00 00 00 05
			E3 04 04 01 01
			39 01 00 00 00 00 02
			B4 00
			39 01 00 00 00 00 03
			B5 05 05
			39 01 00 00 00 00 03
			B6 6D 6D
			39 01 00 00 00 00 03
			B8 64 22
			39 01 00 00 00 00 02
			CC 06
			39 01 00 00 00 00 02
			BC 47
			39 01 00 00 00 00 34
			E9 00 00 07 00 00 04 
			89 12 31 23 13 07 04 
			99 13 00 00 10 00 00 
			04 0F 88 00 09 88 88 
			88 88 88 88 88 11 19 
			88 88 88 88 88 88 00 
			00 00 00 00 00 00 00 
			00 00 00
			39 01 00 00 00 00 29
			EA 90 00 00 00 09 11 
			18 00 00 00 00 00 00 
			09 00 08 00 00 00 00 
			00 00 30 00 00 FF 00 
			00 00 00 00 00 00 00 
			00 00 00 00 00 00
			39 01 00 00 00 00 23
			E0 00 08 0E 25 24 29 
			1D 3D 06 0C 0F 12 14 
			13 14 13 1A 00 08 0E 
			25 24 29 1D 3D 06 0C 
			0F 12 14 13 14 13 1A
			05 01 00 00 96 00 02
			11 00
			05 01 00 00 78 00 02
			29 00];

		qcom,mdss-dsi-off-command = [05 01 00 00 32 00 02 28 00
					05 01 00 00 78 00 02 10 00];
		qcom,mdss-dsi-on-command-state = "dsi_lp_mode";
		qcom,mdss-dsi-off-command-state = "dsi_lp_mode";
		qcom,mdss-dsi-h-sync-pulse = <1>;
		qcom,mdss-dsi-traffic-mode = <2>;
		qcom,mdss-dsi-lane-map = <1>;
		qcom,mdss-dsi-bllp-eof-power-mode;
		qcom,mdss-dsi-bllp-power-mode;
		qcom,mdss-dsi-lane-0-state;
		qcom,mdss-dsi-lane-1-state;
		qcom,mdss-dsi-panel-timings = [75 1A 11 00 3D 45 15 1D 1C 03 04 00];
		qcom,mdss-dsi-t-clk-post = <0x04>;
		qcom,mdss-dsi-t-clk-pre = <0x1b>;
		qcom,mdss-dsi-dma-trigger = <4>;
		qcom,mdss-dsi-mdp-trigger = <0>;
		qcom,mdss-dsi-bl-min-level = <1>;
		qcom,mdss-dsi-bl-max-level = <31>;
		qcom,mdss-dsi-bl-pmic-control-type = "bl_ctrl_gpio";
		qcom,mdss-dsi-reset-sequence = <1 20>, <0 10>, <1 20>;
	};
};
