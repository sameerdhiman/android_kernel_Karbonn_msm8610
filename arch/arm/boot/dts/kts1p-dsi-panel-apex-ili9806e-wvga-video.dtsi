/* Copyright (c) 2013, The Linux Foundation. All rights reserved.
 *
 * This program is free software; you can redistribute it and/or modify
 * it under the terms of the GNU General Public License version 2 and
 * only version 2 as published by the Free Software Foundation.
 *
 * This program is distributed in the hope that it will be useful,
 * but WITHOUT ANY WARRANTY; without even the implied warranty of
 * MERCHANTABILITY or FITNESS FOR A PARTICULAR PURPOSE.  See the
 * GNU General Public License for more details.
 */

/*---------------------------------------------------------------------------
 * This file is autogenerated file using gcdb parser. Please do not edit it.
 * Update input XML file to add a new entry or update variable in this file
 * VERSION = "1.0"
 *---------------------------------------------------------------------------*/

/* =======================================================================
 *
 * when        	who         	why                           					comment tag
 *
 * ----------	---------	-------------------------------------				--------------------------
 * 2014-03-08	guofeizhi	Lower LCM refresh rate to improve wireless performance		FEIXUN_LOWER_LCM_REFRESH_RATE_GUOFEIZHI_001
 *
 */

&mdss_mdp {
	dsi_ili9806e_wvga_vid:qcom,mdss_dsi_ili9806e_wvga_video {
		qcom,mdss-dsi-panel-name = "ili9806e wvga video mode dsi panel";
		qcom,mdss-dsi-panel-controller = <&mdss_dsi0>;
		qcom,mdss-dsi-panel-type = "dsi_video_mode";
		qcom,mdss-dsi-panel-destination = "display_1";
		qcom,mdss-dsi-panel-frame-rate = <60>;
		qcom,mdss-dsi-virtual-channel-id = <0>;
		qcom,mdss-dsi-stream = <0>;
		qcom,mdss-dsi-panel-width = <480>;
		qcom,mdss-dsi-panel-height = <800>;
		qcom,mdss-dsi-h-front-porch = <70>;
		qcom,mdss-dsi-h-back-porch = <70>;
		qcom,mdss-dsi-h-pulse-width = <10>;
		qcom,mdss-dsi-h-sync-skew = <0>;
		qcom,mdss-dsi-v-front-porch = <20>;
		qcom,mdss-dsi-v-back-porch = <16>;
		qcom,mdss-dsi-v-pulse-width = <4>;
		qcom,mdss-dsi-h-left-border = <0>;
		qcom,mdss-dsi-h-right-border = <0>;
		qcom,mdss-dsi-v-top-border = <0>;
		qcom,mdss-dsi-v-bottom-border = <0>;
		qcom,mdss-dsi-bpp = <24>;
		qcom,mdss-dsi-underflow-color = <0xff>;
		qcom,mdss-dsi-border-color = <0>;
		qcom,mdss-dsi-on-command = [39 01 00 00 00 00 06 ff ff 98 06 04 01 39 01 00 00 00 00 02 08 10 39 01 00 00 00 00 02 21 01 39 01 00 00 00 00 02 30 02 39 01 00 00 00 00 02 31 02 39 01 00 00 00 00 02 60 07 39 01 00 00 00 00 02 61 06 39 01 00 00 00 00 02 62 06 39 01 00 00 00 00 02 63 04 39 01 00 00 00 00 02 40 15 39 01 00 00 00 00 02 41 22 39 01 00 00 00 00 02 42 00 39 01 00 00 00 00 02 43 8b 39 01 00 00 00 00 02 44 8c 39 01 00 00 00 00 02 45 1b 39 01 00 00 00 00 02 50 78 39 01 00 00 00 00 02 51 78 39 01 00 00 00 00 02 52 00 39 01 00 00 00 00 02 53 6f 39 01 00 00 00 00 02 a0 00 39 01 00 00 00 00 02 a1 00 39 01 00 00 00 00 02 a2 09 39 01 00 00 00 00 02 a3 12 39 01 00 00 00 00 02 a4 06 39 01 00 00 00 00 02 a5 11 39 01 00 00 00 00 02 a6 01 39 01 00 00 00 00 02 a7 09 39 01 00 00 00 00 02 a8 05 39 01 00 00 00 00 02 a9 07 39 01 00 00 00 00 02 aa 15 39 01 00 00 00 00 02 ab 07 39 01 00 00 00 00 02 ac 14 39 01 00 00 00 00 02 ad 0e 39 01 00 00 00 00 02 ae 11 39 01 00 00 00 00 02 af 00 39 01 00 00 00 00 02 c0 00 39 01 00 00 00 00 02 c1 16 39 01 00 00 00 00 02 c2 1d 39 01 00 00 00 00 02 c3 0a 39 01 00 00 00 00 02 c4 03 39 01 00 00 00 00 02 c5 03 39 01 00 00 00 00 02 c6 0f 39 01 00 00 00 00 02 c7 00 39 01 00 00 00 00 02 c8 0a 39 01 00 00 00 00 02 c9 0d 39 01 00 00 00 00 02 ca 0e 39 01 00 00 00 00 02 cb 08 39 01 00 00 00 00 02 cc 0a 39 01 00 00 00 00 02 cd 14 39 01 00 00 00 00 02 ce 00 39 01 00 00 00 00 02 cf 00 39 01 00 00 00 00 06 ff ff 98 06 04 07 39 01 00 00 00 00 02 18 1d 39 01 00 00 00 00 02 17 12 39 01 00 00 00 00 06 ff ff 98 06 04 06 39 01 00 00 00 00 02 00 20 39 01 00 00 00 00 02 01 05 39 01 00 00 00 00 02 02 00 39 01 00 00 00 00 02 03 00 39 01 00 00 00 00 02 04 01 39 01 00 00 00 00 02 05 01 39 01 00 00 00 00 02 06 88 39 01 00 00 00 00 02 07 04 39 01 00 00 00 00 02 08 01 39 01 00 00 00 00 02 09 90 39 01 00 00 00 00 02 0a 04 39 01 00 00 00 00 02 0b 01 39 01 00 00 00 00 02 0c 01 39 01 00 00 00 00 02 0d 01 39 01 00 00 00 00 02 0e 00 39 01 00 00 00 00 02 0f 00 39 01 00 00 00 00 02 10 55 39 01 00 00 00 00 02 11 50 39 01 00 00 00 00 02 12 01 39 01 00 00 00 00 02 13 0c 39 01 00 00 00 00 02 14 0d 39 01 00 00 00 00 02 15 43 39 01 00 00 00 00 02 16 0b 39 01 00 00 00 00 02 17 00 39 01 00 00 00 00 02 18 00 39 01 00 00 00 00 02 19 00 39 01 00 00 00 00 02 1a 00 39 01 00 00 00 00 02 1b 00 39 01 00 00 00 00 02 1c 00 39 01 00 00 00 00 02 1d 00 39 01 00 00 00 00 02 20 01 39 01 00 00 00 00 02 21 23 39 01 00 00 00 00 02 22 45 39 01 00 00 00 00 02 23 67 39 01 00 00 00 00 02 24 01 39 01 00 00 00 00 02 25 23 39 01 00 00 00 00 02 26 45 39 01 00 00 00 00 02 27 67 39 01 00 00 00 00 02 30 02 39 01 00 00 00 00 02 31 22 39 01 00 00 00 00 02 32 11 39 01 00 00 00 00 02 33 aa 39 01 00 00 00 00 02 34 bb 39 01 00 00 00 00 02 35 66 39 01 00 00 00 00 02 36 00 39 01 00 00 00 00 02 37 22 39 01 00 00 00 00 02 38 22 39 01 00 00 00 00 02 39 22 39 01 00 00 00 00 02 3a 22 39 01 00 00 00 00 02 3b 22 39 01 00 00 00 00 02 3c 22 39 01 00 00 00 00 02 3d 22 39 01 00 00 00 00 02 3e 22 39 01 00 00 00 00 02 3f 22 39 01 00 00 00 00 02 40 22 39 01 00 00 00 00 02 53 1a 39 01 00 00 00 00 06 ff ff 98 06 04 00 05 01 00 00 96 00 02 11 00 05 01 00 00 78 00 02 29 00];
		qcom,mdss-dsi-off-command = [05 01 00 00 32 00 02 28 00 05 01 00 00 78 00 02 10 00];
		qcom,mdss-dsi-on-command-state = "dsi_lp_mode";
		qcom,mdss-dsi-off-command-state = "dsi_lp_mode";
		qcom,mdss-dsi-h-sync-pulse = <1>;
		qcom,mdss-dsi-traffic-mode = "non_burst_sync_pulse";
		qcom,mdss-dsi-lane-map = "lane_map_3012";
		qcom,mdss-dsi-bllp-eof-power-mode;
		qcom,mdss-dsi-bllp-power-mode;
		qcom,mdss-dsi-lane-0-state;
		qcom,mdss-dsi-lane-1-state;
		qcom,mdss-dsi-panel-timings = [75 1A 11 00 3D 45 15 1D 1C 03 04 00];
		qcom,mdss-dsi-t-clk-post = <0x04>;
		qcom,mdss-dsi-t-clk-pre = <0x1b>;
		qcom,mdss-dsi-bl-min-level = <1>;
		qcom,mdss-dsi-bl-max-level = <31>;
		qcom,mdss-dsi-dma-trigger = "trigger_sw";
		qcom,mdss-dsi-mdp-trigger = "none";
		qcom,mdss-dsi-bl-pmic-control-type = "bl_ctrl_gpio";
		qcom,mdss-dsi-reset-sequence = <1 20>, <0 20>, <1 120>;
	};
};
